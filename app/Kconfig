## app/Kconfig
```kconfig
# Copyright (c) 2021 Nordic Semiconductor ASA
# SPDX-License-Identifier: Apache-2.0
#
# This file is the application Kconfig entry point. All application Kconfig
# options can be defined here or included via other application Kconfig files.
# You can browse these options using the west targets menuconfig (terminal) or
# guiconfig (GUI).

menu "Zephyr"
source "Kconfig.zephyr"
endmenu

module = APP
module-str = APP
source "subsys/logging/Kconfig.template.log_config"

config FETURE
	bool "Activate example for stm32f302"
	default n
	depends on DT_HAS_BLINK_GPIO_LED_ENABLED
	select GPIO
	help
	  Enable this option to use the GPIO-controlled LED blink driver. This
	  demonstrates how to implement a driver for a custom driver class.
```
